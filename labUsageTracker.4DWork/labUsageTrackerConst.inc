// File generated 5/11/2015 3:57:31 PM
// Warning! This is a generated file, any manual changes will be
// lost during the next generation.

#constant  Strings0Count    0
#constant  Strings0Size     1
#constant  Strings8Count    0
#constant  Strings8Size     1
#constant  Strings9Count    8
#constant  Strings9Size     10
#constant  Strings1Count    0
#constant  Strings1Size     1
#constant  Strings2Count    0
#constant  Strings2Size     1
#DATA
    byte iKeyboard0keystrokes 0x37, 0x38, 0x39, 0x6B, 0x34, 0x35, 0x36, 0x31, 0x32, 0x33, 0x0D, 0x30, 0x6E
#END


// object indexes into ImageControl
#CONST
    iKeyboard0      // offset 0x0
    iKeyboard0_0    // offset 0x20200
    iKeyboard0_1    // offset 0x24200
    iKeyboard0_2    // offset 0x28200
    iKeyboard0_3    // offset 0x2C200
    iKeyboard0_4    // offset 0x34200
    iKeyboard0_5    // offset 0x38200
    iKeyboard0_6    // offset 0x3C200
    iKeyboard0_7    // offset 0x40200
    iKeyboard0_8    // offset 0x44200
    iKeyboard0_9    // offset 0x48200
    iKeyboard0_10   // offset 0x4C200
    iKeyboard0_11   // offset 0x54200
    iKeyboard0_12   // offset 0x5C000
    iStatictext0    // offset 0x60000
    iStatictext5    // offset 0x60C00
    iStatictext6    // offset 0x62800
    iUserbutton0    // offset 0x63000
    iUserbutton1    // offset 0x71E00
    iUserbutton2    // offset 0x7BC00
#END

#constant  Strings3Size     0
#constant  Strings3StartH   0
#constant  Strings3StartL   0
#constant  Strings4Size     0
#constant  Strings4StartH   0
#constant  Strings4StartL   0
#constant  Strings5Size     0
#constant  Strings5StartH   0
#constant  Strings5StartL   0
#constant  Strings6Size     0
#constant  Strings6StartH   0
#constant  Strings6StartL   0
#constant  Strings7Size     0
#constant  Strings7StartH   0
#constant  Strings7StartL   0
#constant  Strings0StartH   0x0
#constant  Strings0StartL   0x0
#constant  Strings8StartH   0x0
#constant  Strings8StartL   0x200
#constant  Strings9StartH   0x0
#constant  Strings9StartL   0x400
#constant  Strings1StartH   0x0
#constant  Strings1StartL   0x600
#constant  Strings2StartH   0x0
#constant  Strings2StartL   0x800
#IFNOT EXISTS NOGLOBALS
var disk, hndl ;
var oKeyboard0[12] := [-1, 0, 0, 0, 0, 255, 255, 255, 255, 255, 13, 0] ;
#ENDIF
